## arch/arm/common/Kconfig
```kconfig
config ARM_GIC
	select IRQ_DOMAIN
	select MULTI_IRQ_HANDLER
	bool

config GIC_NON_BANKED
	bool

config ARM_VIC
	select IRQ_DOMAIN
	select MULTI_IRQ_HANDLER
	bool

config ARM_VIC_NR
	int
	default 4 if ARCH_S5PV210
	default 3 if ARCH_S5PC100
	default 2
	depends on ARM_VIC
	help
	  The maximum number of VICs available in the system, for
	  power management.

config ICST
	bool

config PL330
	bool

config SA1111
	bool
	select DMABOUNCE if !ARCH_PXA

config DMABOUNCE
	bool
	select ZONE_DMA

config TIMER_ACORN
	bool

config SHARP_LOCOMO
	bool

config SHARP_PARAM
	bool

config SHARP_SCOOP
	bool

config GIC_SET_MULTIPLE_CPUS
	bool "Use affinity hint to allow multiple CPUs for IRQ"
	depends on ARM_GIC && SMP
	default n
	help
	  IRQ affinity is always set by gic to the 1st cpu in the requested
	  mask. If this option is enabled, affinity is also set to all cpus
	  present in affinity_hint and requested masks.
```

## arch/arm/configs/cl2n_defconfig
```kconfig
CONFIG_IKCONFIG_PROC=y
CONFIG_OPROFILE=y
CONFIG_GPIO_PCA953X=y
CONFIG_MACH_CL2N=y
CONFIG_SCHED_SMT=y
CONFIG_USE_OF=y
CONFIG_IP_PNP=y
CONFIG_IP_PNP_DHCP=y
CONFIG_IP_PNP_BOOTP=y
CONFIG_IP_PNP_RARP=y
# CONFIG_INET_XFRM_MODE_TUNNEL is not set
# CONFIG_INET_XFRM_MODE_BEET is not set
# CONFIG_INET_DIAG is not set
CONFIG_IPV6_TUNNEL=y
CONFIG_NF_CONNTRACK_SIP=y
CONFIG_NETFILTER_XT_MATCH_CONNBYTES=y
CONFIG_IP6_NF_SECURITY=y
CONFIG_NET_SCH_INGRESS=y
CONFIG_NET_ACT_POLICE=y
CONFIG_NET_ACT_GACT=y
CONFIG_NET_ACT_MIRRED=y
CONFIG_NL80211_TESTMODE=y
CONFIG_LIB80211=y
CONFIG_MAC80211=y
CONFIG_CAIF=y
CONFIG_NFC=y
CONFIG_PN544_NFC=y
# CONFIG_FIRMWARE_IN_KERNEL is not set
CONFIG_AD525X_DPOT=y
CONFIG_AD525X_DPOT_I2C=y
CONFIG_APDS9802ALS=y
CONFIG_MAX1749_VIBRATOR=y
CONFIG_LIS3DH_ACCELEROMETER=y
CONFIG_PPP_FILTER=y
CONFIG_PPP_ASYNC=y
CONFIG_PPP_SYNC_TTY=y
CONFIG_USB_USBNET=y
CONFIG_USB_NET_SMSC95XX=y
# CONFIG_USB_NET_NET1080 is not set
# CONFIG_USB_BELKIN is not set
# CONFIG_USB_ARMLINUX is not set
# CONFIG_USB_NET_ZAURUS is not set
CONFIG_USB_NET_RAW_IP=y
CONFIG_BCMDHD_FW_PATH="/system/vendor/firmware/fw_bcmdhd.bin"
CONFIG_BCMDHD_NVRAM_PATH="/system/etc/nvram_4330.txt"
CONFIG_TOUCHSCREEN_FT5X06=y
CONFIG_INV_AK8975=y
CONFIG_INV_MPU=y
CONFIG_INPUT_SOLTEAM_JSA1127=y
CONFIG_SERIAL_8250=y
CONFIG_SERIAL_8250_CONSOLE=y
CONFIG_GPIO_MAX77663=y
CONFIG_BATTERY_BQ27x00=y
# CONFIG_BATTERY_BQ27X00_PLATFORM is not set
CONFIG_CHARGER_SMB349=y
CONFIG_CHARGER_GPIO=y
CONFIG_SENSORS_TEGRA_TSENSOR=y
CONFIG_SENSORS_INA219=y
CONFIG_AIC3XXX_CORE=y
CONFIG_MFD_MAX77663=y
CONFIG_REGULATOR_USERSPACE_CONSUMER=y
CONFIG_REGULATOR_GPIO=y
CONFIG_REGULATOR_MAX77663=y
CONFIG_VIDEO_S5K5CAG=y
CONFIG_VIDEO_MT9M114_CL2N=y
CONFIG_TEGRA_NVHDCP=y
CONFIG_SND_HDA_INTEL=y
CONFIG_SND_HDA_PLATFORM_DRIVER=y
CONFIG_SND_HDA_PLATFORM_NVIDIA_TEGRA=y
CONFIG_SND_HDA_POWER_SAVE=y
CONFIG_SND_HDA_POWER_SAVE_DEFAULT=10
CONFIG_SND_SOC_TEGRA_TLV320AIC326X=y
CONFIG_MMC_TEST=y
CONFIG_NEW_LEDS=y
CONFIG_LEDS_CLASS=y
CONFIG_LEDS_GPIO=y
CONFIG_USB_SERIAL_BASEBAND=y
CONFIG_RTC_DRV_MAX77663=y
CONFIG_ANDROID_TIMED_GPIO=y
CONFIG_ROOT_NFS=y
CONFIG_DEBUG_SECTION_MISMATCH=y
CONFIG_LOCKUP_DETECTOR=y
# CONFIG_DETECT_HUNG_TASK is not set
CONFIG_DEBUG_VM=y
CONFIG_FAULT_INJECTION=y
CONFIG_FAILSLAB=y
CONFIG_FAULT_INJECTION_DEBUG_FS=y
CONFIG_FAULT_INJECTION_STACKTRACE_FILTER=y
# CONFIG_FUNCTION_GRAPH_TRACER is not set
CONFIG_CRYPTO_DEV_TEGRA_AES=y
```

## arch/arm/configs/grouper_defconfig
```kconfig
CONFIG_MACH_GROUPER=y
CONFIG_TEGRA_BB_XMM_POWER=y
CONFIG_CMDLINE="tegra_wdt.heartbeat=30"
CONFIG_PM_DEBUG=y
CONFIG_IP_MULTICAST=y
CONFIG_NFC=y
CONFIG_PN544_NFC=y
CONFIG_CMA=y
CONFIG_USB_NET_RNDIS_WLAN=y
CONFIG_USB_NET_RAW_IP=y
CONFIG_BCMDHD_FW_PATH="/system/vendor/firmware/fw_bcmdhd.bin"
CONFIG_BCMDHD_NVRAM_PATH="/system/etc/nvram.txt"
CONFIG_DHD_USE_SCHED_SCAN=y
CONFIG_INPUT_LID=y
CONFIG_TOUCHSCREEN_ELAN_TF_3K=y
CONFIG_INPUT_KEYCHORD=y
CONFIG_SENSORS_CAP1106=y
CONFIG_GPIO_MAX77663=y
CONFIG_GPIO_TPS65910=y
CONFIG_BATTERY_BQ27x00=y
CONFIG_CHARGER_GPIO=y
CONFIG_CHARGER_SMB347=y
CONFIG_SENSORS_TEGRA_TSENSOR=y
CONFIG_SENSORS_AL3010=y
CONFIG_MFD_TPS65910=y
CONFIG_MFD_MAX77663=y
CONFIG_MFD_TPS6591X=y
CONFIG_REGULATOR_MAX77663=y
CONFIG_REGULATOR_TPS62360=y
CONFIG_REGULATOR_TPS65910=y
CONFIG_REGULATOR_TPS6591X=y
CONFIG_VIDEO_MI1040=y
CONFIG_SND_SOC_TEGRA_RT5640=y
CONFIG_HEADSET_FUNCTION=y
CONFIG_USB_HIDDEV=y
CONFIG_USB_SERIAL_BASEBAND=y
CONFIG_RTC_DRV_MAX77663=y
CONFIG_RTC_DRV_TPS6591x=y
CONFIG_ANDROID_TIMED_GPIO=y
CONFIG_IIO=y
CONFIG_IIO_BUFFER=y
CONFIG_IIO_KFIFO_BUF=y
CONFIG_INV_MPU_IIO=y
CONFIG_INV_AMI306_IIO=y
CONFIG_RIL=y
CONFIG_AVERAGE=y
```

## arch/arm/configs/picasso_defconfig
```kconfig
CONFIG_RD_LZMA=y
CONFIG_ARCH_ACER_T30=y
CONFIG_MACH_PICASSO=y
CONFIG_CMDLINE="tegra_wdt.heartbeat=30"
CONFIG_BCM4329_RFKILL=y
CONFIG_STK2203_LIGHT_SENSOR=y
CONFIG_EEPROM_AT24C02C=y
CONFIG_MPU_SENSORS_TIMERIRQ=y
CONFIG_INV_SENSORS=y
CONFIG_MPU_SENSORS_MPU3050=y
CONFIG_MPU_SENSORS_KXTF9=y
CONFIG_MPU_SENSORS_AK8975=y
CONFIG_BCMDHD_NVRAM_PATH="/vendor/firmware/bcmdhd.cal"
CONFIG_DHD_USE_SCHED_SCAN=y
CONFIG_TOUCHSCREEN_ATMEL_MXT=y
CONFIG_GPIO_TPS65910=y
CONFIG_BATTERY_BQ27x00=y
CONFIG_CHARGER_GPIO=y
CONFIG_SENSORS_TEGRA_TSENSOR=y
CONFIG_MFD_TPS65910=y
CONFIG_MFD_TPS6591X=y
CONFIG_REGULATOR_GPIO=y
CONFIG_REGULATOR_TPS62360=y
CONFIG_REGULATOR_TPS65910=y
CONFIG_REGULATOR_TPS6591X=y
CONFIG_VIDEO_OV5640_ACER=y
CONFIG_VIDEO_OV9740=y
CONFIG_TEGRA_NVHDCP=y
CONFIG_SND_HDA_INTEL=y
CONFIG_SND_HDA_PLATFORM_DRIVER=y
CONFIG_SND_HDA_PLATFORM_NVIDIA_TEGRA=y
CONFIG_SND_HDA_POWER_SAVE=y
CONFIG_SND_HDA_POWER_SAVE_DEFAULT=10
CONFIG_SND_SOC_TEGRA_WM8903=y
CONFIG_ACER_ES305=y
CONFIG_MMC_PARANOID_SD_INIT=y
CONFIG_ACER_LEDS=y
CONFIG_SWITCH_GPIO=y
CONFIG_SIMDETECT=y
CONFIG_RTC_DRV_TPS6591x=y
```

## arch/arm/configs/picasso_recovery_defconfig
```kconfig
CONFIG_EXPERIMENTAL=y
CONFIG_KERNEL_XZ=y
CONFIG_AUDIT=y
CONFIG_IKCONFIG=y
CONFIG_CGROUPS=y
CONFIG_CGROUP_FREEZER=y
CONFIG_CGROUP_CPUACCT=y
CONFIG_RESOURCE_COUNTERS=y
CONFIG_CGROUP_SCHED=y
CONFIG_RT_GROUP_SCHED=y
CONFIG_BLK_DEV_INITRD=y
CONFIG_RD_LZMA=y
CONFIG_PANIC_TIMEOUT=5
# CONFIG_ELF_CORE is not set
CONFIG_EMBEDDED=y
# CONFIG_PCI_QUIRKS is not set
CONFIG_SLAB=y
# CONFIG_BLK_DEV_BSG is not set
CONFIG_PARTITION_ADVANCED=y
CONFIG_EFI_PARTITION=y
CONFIG_ARCH_TEGRA=y
CONFIG_ARCH_TEGRA_3x_SOC=y
CONFIG_ARCH_ACER_T30=y
CONFIG_MACH_PICASSO=y
CONFIG_TEGRA_PWM=y
CONFIG_TEGRA_EMC_SCALING_ENABLE=y
CONFIG_TEGRA_CLOCK_DEBUG_WRITE=y
CONFIG_USB_HOTPLUG=y
CONFIG_TEGRA_GADGET_BOOST_CPU_FREQ=800
CONFIG_TEGRA_DYNAMIC_PWRDET=y
CONFIG_TEGRA_PLLM_RESTRICTED=y
CONFIG_ARM_ERRATA_742230=y
CONFIG_ARM_ERRATA_752520=y
CONFIG_NO_HZ=y
CONFIG_HIGH_RES_TIMERS=y
CONFIG_SMP=y
CONFIG_SCHED_MC=y
CONFIG_PREEMPT=y
CONFIG_AEABI=y
# CONFIG_OABI_COMPAT is not set
CONFIG_HIGHMEM=y
CONFIG_COMPACTION=y
CONFIG_ARM_FLUSH_CONSOLE_ON_RESTART=y
CONFIG_ZBOOT_ROM_TEXT=0x0
CONFIG_ZBOOT_ROM_BSS=0x0
CONFIG_CMDLINE="tegra_wdt.heartbeat=30"
CONFIG_CMDLINE_EXTEND=y
CONFIG_CPU_FREQ=y
CONFIG_CPU_FREQ_DEFAULT_GOV_USERSPACE=y
CONFIG_CPU_FREQ_GOV_INTERACTIVE=y
CONFIG_CPU_IDLE=y
CONFIG_CPUQUIET_FRAMEWORK=y
CONFIG_CPUQUIET_STATS=y
CONFIG_CPUQUIET_DEFAULT_GOV_BALANCED=y
CONFIG_VFP=y
CONFIG_NEON=y
CONFIG_KERNEL_MODE_NEON=y
CONFIG_PM_AUTOSLEEP=y
CONFIG_PM_WAKELOCKS=y
CONFIG_PM_WAKELOCKS_LIMIT=0
# CONFIG_PM_WAKELOCKS_GC is not set
CONFIG_PM_RUNTIME=y
CONFIG_NET=y
CONFIG_PACKET=y
CONFIG_UNIX=y
CONFIG_XFRM_USER=y
CONFIG_NET_KEY=y
CONFIG_INET=y
CONFIG_SYNC=y
CONFIG_CMA=y
CONFIG_BLK_DEV_LOOP=y
CONFIG_BLK_DEV_RAM=y
CONFIG_BLK_DEV_RAM_SIZE=8192
CONFIG_SENSORS_NCT1008=y
CONFIG_TEGRA_CRYPTO_DEV=y
CONFIG_SCSI=y
CONFIG_BLK_DEV_SD=y
CONFIG_BLK_DEV_SR=y
CONFIG_BLK_DEV_SR_VENDOR=y
CONFIG_CHR_DEV_SG=y
CONFIG_SCSI_MULTI_LUN=y
CONFIG_MD=y
CONFIG_BLK_DEV_DM=y
CONFIG_DM_CRYPT=y
CONFIG_DM_UEVENT=y
CONFIG_DM_VERITY=y
CONFIG_NETDEVICES=y
CONFIG_DUMMY=y
CONFIG_TUN=y
CONFIG_PPP=y
CONFIG_PPP_BSDCOMP=y
CONFIG_PPP_DEFLATE=y
CONFIG_PPP_MPPE=y
CONFIG_PPPOLAC=y
CONFIG_PPPOPNS=y
# CONFIG_INPUT_MOUSEDEV is not set
CONFIG_INPUT_EVDEV=y
CONFIG_INPUT_KEYRESET=y
# CONFIG_KEYBOARD_ATKBD is not set
CONFIG_KEYBOARD_GPIO=y
# CONFIG_INPUT_MOUSE is not set
CONFIG_INPUT_TOUCHSCREEN=y
CONFIG_TOUCHSCREEN_ATMEL_MXT=y
CONFIG_INPUT_MISC=y
CONFIG_INPUT_KEYCHORD=y
CONFIG_INPUT_UINPUT=y
CONFIG_INPUT_GPIO=y
# CONFIG_SERIO is not set
# CONFIG_VT is not set
# CONFIG_LEGACY_PTYS is not set
# CONFIG_DEVMEM is not set
# CONFIG_DEVKMEM is not set
CONFIG_SERIAL_TEGRA=y
# CONFIG_HW_RANDOM is not set
# CONFIG_I2C_COMPAT is not set
CONFIG_I2C_CHARDEV=y
# CONFIG_I2C_HELPER_AUTO is not set
CONFIG_I2C_TEGRA=y
CONFIG_SPI=y
CONFIG_SPI_TEGRA=y
CONFIG_SPI_SLAVE_TEGRA=y
CONFIG_DEBUG_GPIO=y
CONFIG_GPIO_SYSFS=y
CONFIG_GPIO_TPS65910=y
CONFIG_POWER_SUPPLY=y
CONFIG_BATTERY_BQ27x00=y
CONFIG_CHARGER_GPIO=y
CONFIG_SENSORS_TEGRA_TSENSOR=y
CONFIG_THERMAL=y
CONFIG_WATCHDOG=y
CONFIG_TEGRA_WATCHDOG=y
CONFIG_TEGRA_WATCHDOG_ENABLE_ON_PROBE=y
CONFIG_MFD_TPS65910=y
CONFIG_MFD_TPS6591X=y
CONFIG_REGULATOR=y
CONFIG_REGULATOR_FIXED_VOLTAGE=y
CONFIG_REGULATOR_VIRTUAL_CONSUMER=y
CONFIG_REGULATOR_GPIO=y
CONFIG_REGULATOR_TPS62360=y
CONFIG_REGULATOR_TPS65910=y
CONFIG_REGULATOR_TPS6591X=y
CONFIG_FB=y
CONFIG_TEGRA_GRHOST=y
CONFIG_TEGRA_DC=y
CONFIG_NVMAP_ALLOW_SYSMEM=y
CONFIG_TEGRA_DSI=y
CONFIG_BACKLIGHT_LCD_SUPPORT=y
# CONFIG_BACKLIGHT_GENERIC is not set
CONFIG_BACKLIGHT_PWM=y
CONFIG_BACKLIGHT_TEGRA_PWM=y
CONFIG_SOUND=y
CONFIG_SND=y
CONFIG_SND_SOC=y
CONFIG_SND_SOC_TEGRA=y
CONFIG_SND_SOC_TEGRA_WM8903=y
CONFIG_USB=y
CONFIG_USB_ANNOUNCE_NEW_DEVICES=y
CONFIG_USB_DEVICEFS=y
CONFIG_USB_SUSPEND=y
CONFIG_USB_OTG=y
# CONFIG_USB_OTG_WHITELIST is not set
CONFIG_USB_EHCI_HCD=y
CONFIG_USB_EHCI_TEGRA=y
CONFIG_USB_ACM=y
CONFIG_USB_WDM=y
CONFIG_USB_STORAGE=y
CONFIG_USB_LIBUSUAL=y
CONFIG_USB_SERIAL=y
CONFIG_USB_SERIAL_PL2303=y
CONFIG_USB_SERIAL_OPTION=y
CONFIG_USB_GADGET=y
CONFIG_USB_GADGET_VBUS_DRAW=500
CONFIG_USB_TEGRA=y
CONFIG_USB_G_ANDROID=y
CONFIG_USB_OTG_WAKELOCK=y
CONFIG_USB_TEGRA_OTG=y
CONFIG_MMC=y
CONFIG_MMC_UNSAFE_RESUME=y
CONFIG_MMC_EMBEDDED_SDIO=y
CONFIG_MMC_PARANOID_SD_INIT=y
CONFIG_MMC_BLOCK_MINORS=32
CONFIG_MMC_SDHCI=y
CONFIG_MMC_SDHCI_PLTFM=y
CONFIG_MMC_SDHCI_TEGRA=y
CONFIG_SWITCH=y
CONFIG_SWITCH_GPIO=y
CONFIG_RTC_CLASS=y
CONFIG_RTC_DRV_TPS6591x=y
CONFIG_STAGING=y
CONFIG_ANDROID=y
CONFIG_ANDROID_BINDER_IPC=y
CONFIG_ANDROID_BINDER_IPC_32BIT=y
CONFIG_ASHMEM=y
CONFIG_ANDROID_RAM_CONSOLE=y
CONFIG_ANDROID_LOW_MEMORY_KILLER=y
CONFIG_TEGRA_IOMMU_SMMU=y
CONFIG_PM_DEVFREQ=y
CONFIG_EXT2_FS=y
CONFIG_EXT2_FS_XATTR=y
CONFIG_EXT2_FS_POSIX_ACL=y
CONFIG_EXT2_FS_SECURITY=y
CONFIG_EXT3_FS=y
# CONFIG_EXT3_DEFAULTS_TO_ORDERED is not set
CONFIG_EXT3_FS_POSIX_ACL=y
CONFIG_EXT3_FS_SECURITY=y
CONFIG_EXT4_FS=y
CONFIG_EXT4_FS_POSIX_ACL=y
CONFIG_EXT4_FS_SECURITY=y
CONFIG_F2FS_FS=y
CONFIG_F2FS_FS_SECURITY=y
# CONFIG_DNOTIFY is not set
CONFIG_FUSE_FS=y
CONFIG_MSDOS_FS=y
CONFIG_VFAT_FS=y
CONFIG_NTFS_FS=y
CONFIG_TMPFS=y
CONFIG_TMPFS_POSIX_ACL=y
CONFIG_NFS_FS=y
CONFIG_NLS_CODEPAGE_437=y
CONFIG_NLS_ISO8859_1=y
CONFIG_PRINTK_TIME=y
CONFIG_DEBUG_FS=y
CONFIG_SCHEDSTATS=y
# CONFIG_DEBUG_PREEMPT is not set
CONFIG_SECURITY=y
CONFIG_SECURITY_NETWORK=y
CONFIG_LSM_MMAP_MIN_ADDR=4096
CONFIG_SECURITY_SELINUX=y
CONFIG_TRUSTED_FOUNDATIONS=y
CONFIG_CRYPTO_SHA1_ARM_NEON=y
CONFIG_CRYPTO_SHA256=y
CONFIG_CRYPTO_AES_ARM_BS=y
CONFIG_CRYPTO_TWOFISH=y
# CONFIG_CRYPTO_ANSI_CPRNG is not set
CONFIG_CRYPTO_DEV_TEGRA_SE=y
CONFIG_AVERAGE=y
```

## arch/arm/configs/transformer_defconfig
```kconfig
CONFIG_RD_LZMA=y
CONFIG_ARCH_ASUS_T30=y
CONFIG_MACH_TRANSFORMER=y
CONFIG_TEGRA_BB_XMM_POWER=y
CONFIG_CMDLINE="tegra_wdt.heartbeat=30 androidboot.selinux=permissive"
CONFIG_IP_MULTICAST=y
CONFIG_USB_NET_RNDIS_WLAN=y
CONFIG_USB_NET_RAW_IP=y
CONFIG_BCMDHD_NVRAM_PATH="/system/etc"
# CONFIG_DHD_USE_SCHED_SCAN is not set
CONFIG_INPUT_ASUSEC=y
CONFIG_ASUSPEC=y
CONFIG_ASUSDEC=y
CONFIG_TOUCHSCREEN_ELAN_TF_3K=y
CONFIG_TOUCHSCREEN_ATMEL_MXT=y
CONFIG_GPIO_TPS65910=y
CONFIG_BATTERY_PAD=y
CONFIG_SENSORS_AL3010=y
CONFIG_MFD_TPS65910=y
CONFIG_MFD_TPS6591X=y
CONFIG_REGULATOR_TPS65910=y
CONFIG_REGULATOR_TPS62360=y
CONFIG_REGULATOR_TPS6591X=y
CONFIG_TEGRA_NVHDCP=y
CONFIG_SND_HDA_INTEL=y
CONFIG_SND_HDA_PLATFORM_DRIVER=y
CONFIG_SND_HDA_PLATFORM_NVIDIA_TEGRA=y
CONFIG_SND_SOC_TEGRA_RT5631=y
CONFIG_SND_SOC_TEGRA_WM8903=y
CONFIG_AUDIO_DOCK=y
CONFIG_DSP_FM34=y
CONFIG_HEADSET_FUNCTION=y
CONFIG_USB_HIDDEV=y
CONFIG_USB_SERIAL_BASEBAND=y
CONFIG_RTC_DRV_TPS6591x=y
CONFIG_ANDROID_TIMED_GPIO=y
CONFIG_INV_SENSORS_TIMERIRQ=y
CONFIG_INV_SENSORS=y
CONFIG_INV_SENSORS_MPU3050=y
CONFIG_INV_SENSORS_MPU3050_GYRO=y
CONFIG_INV_SENSORS_ACCELEROMETERS=y
CONFIG_INV_SENSORS_KXTF9=y
CONFIG_INV_SENSORS_COMPASS=y
CONFIG_INV_SENSORS_AMI306=y
CONFIG_INV_SENSORS_PRESSURE=y
# CONFIG_RIL is not set // fix
CONFIG_DECOMPRESS_LZMA=y
```

## drivers/input/asusec/Kconfig
```kconfig
#
# Asus input device configuration
#

config INPUT_ASUSEC
	bool "ASUS embedded controller interface"
	depends on I2C

config ASUSPEC
	bool "ASUS embedded controller interface"
	depends on INPUT_ASUSEC

config ASUSDEC
	bool "ASUS embedded controller interface"
	depends on INPUT_ASUSEC
```

## drivers/misc/mpu3050/Kconfig
```kconfig
menu "Motion Sensors Support"

config MPU_SENSORS_TIMERIRQ
    tristate "MPU Timer IRQ"
    help
      If you say yes here you get access to the timerirq device handle which
      can be used to select on.  This can be used instead of IRQ's, sleeping,
      or timer threads.  Reading from this device returns the same type of
      information as reading from the MPU and slave IRQ's.

menuconfig: INV_SENSORS
    tristate "Motion Processing Unit"
    depends on I2C

if INV_SENSORS

choice
    prompt "MPU Master"
    depends on I2C && INV_SENSORS
    optional

config MPU_SENSORS_MPU3050
    bool "MPU3050"
    depends on I2C
    help
      If you say yes here you get support for the MPU3050 Gyroscope driver
      This driver can also be built as a module.  If so, the module
      will be called mpu3050.

endchoice

choice
    prompt "Gyroscope Type"
    depends on I2C && INV_SENSORS
    optional

config MPU_SENSORS_MPU3050_GYRO
    tristate "MPU3050 built in gyroscope"
    depends on MPU_SENSORS_MPU3050

endchoice

choice
    prompt "Accelerometer Type"
    depends on I2C
    optional

config MPU_SENSORS_KXTF9
    bool "Kionix KXTF9"
    depends on MPU_SENSORS_MPU3050
    help
      This enables support for the Kionix KXFT9 accelerometer
endchoice

choice
    prompt "Compass Type"
    optional

config MPU_SENSORS_AK8975
    bool "AKM ak8975"
    depends on MPU_SENSORS_MPU3050
    help
      This enables support for the AKM ak8975 compass
endchoice

endif #INV_SENSORS

endmenu
```
